## kernels/rtlsdk32-linux-2.6.30/net/bridge/Kconfig
```kconfig
#
# 802.1d Ethernet Bridging
#

config BRIDGE
	tristate "802.1d Ethernet Bridging"
	select LLC
	select STP
	---help---
	  If you say Y here, then your Linux box will be able to act as an
	  Ethernet bridge, which means that the different Ethernet segments it
	  is connected to will appear as one Ethernet to the participants.
	  Several such bridges can work together to create even larger
	  networks of Ethernets using the IEEE 802.1 spanning tree algorithm.
	  As this is a standard, Linux bridges will cooperate properly with
	  other third party bridge products.

	  In order to use the Ethernet bridge, you'll need the bridge
	  configuration tools; see <file:Documentation/networking/bridge.txt>
	  for location. Please read the Bridge mini-HOWTO for more
	  information.

	  If you enable iptables support along with the bridge support then you
	  turn your bridge into a bridging IP firewall.
	  iptables will then see the IP packets being bridged, so you need to
	  take this into account when setting up your firewall rules.
	  Enabling arptables support when bridging will let arptables see
	  bridged ARP traffic in the arptables FORWARD chain.

	  To compile this code as a module, choose M here: the module
	  will be called bridge.

	  If unsure, say N.
config RTL_STP
        bool "Enable RealTek STP"
        default n
        depends on BRIDGE

config RTL_WLAN_BLOCK_RELAY
	bool
	default y
	depends on BRIDGE

config RTL_HW_STP
        bool "Enable RealTek Hardware STP"
        default n
        depends on BRIDGE

config BRIDGE_MULTICAST_BWCTRL
	bool "Multicast packet bandwidth control"
	depends on BRIDGE
	---help---

config BRIDGE_E_PARTITION_BWCTRL
	bool "Ethernet to Wlan Access control"
	depends on BRIDGE
	---help---

config BRIDGE_MDNSFILTER_BWCTRL
	bool "Mdns response filter"
	default n
	depends on BRIDGE
config BRIDGE_ALPHA_MULTICAST_SNOOP
	bool "Bridge with Multicast snooping and wireless enhance support"
	depends on BRIDGE
	---help---
	  Deliver support for multicast table, which allow to do multicast snooping 
	  (if implemented in switch) and do wireless enhance mode.
	  Wireless enhance mode will convert multicast data packet to unicast data.
	  Note : this option can't be used together with BRIDGE_IGMPP_PROCFS, since 
	  it is intended to replace the BRIDGE_IGMPP_PROCFS in the future. 

config BRIDGE_ALPHA_MULTICAST_SNOOP_DEBUG
	bool "Bridge with Multicast snooping and wireless enhance support debugging"
    depends on BRIDGE_ALPHA_MULTICAST_SNOOP
	select PRINTK
    ---help---
```
